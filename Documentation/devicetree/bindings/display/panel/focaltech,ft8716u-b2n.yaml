## Documentation/devicetree/bindings/display/panel/focaltech,ft8716u-b2n.yaml
```yaml
# SPDX-License-Identifier: (GPL-2.0-only OR BSD-2-Clause)
%YAML 1.2
---
$id: http://devicetree.org/schemas/display/panel/focaltech,ft8716u-b2n.yaml#
$schema: http://devicetree.org/meta-schemas/core.yaml#

title: Focaltech FT8716U MIPI-DSI panel for B2N

maintainers:
  - Daniel Florian <daniel.florian@floridan.net>

description:
  Focaltech FT8716U 6" 1080x2160 LCD panel found in Nokia 7 Plus smartphone.

allOf:
  - $ref: panel-common.yaml#

properties:
  compatible:
    items:
      - const: focaltech,ft8716u-b2n

  reg:
    maxItems: 1

  iovcc-supply:
    description: I/O voltage rail

  vsn-supply:
    description: Negative source voltage rail

  vsp-supply:
    description: Positive source voltage rail

required:
  - compatible
  - reg
  - reset-gpios
  - iovcc-supply
  - port

unevaluatedProperties: false

examples:
  - |
    #include <dt-bindings/gpio/gpio.h>

    dsi {
        #address-cells = <1>;
        #size-cells = <0>;

        panel@0 {
            compatible = "focaltech,ft8716u-b2n";
            reg = <0>;
            iovcc-supply = <&vreg_l11a_1p8>;
            reset-gpios = <&tlmm 53 GPIO_ACTIVE_LOW>;

            port {
                panel_in: endpoint {
                    remote-endpoint = <&dsi_out>;
                };
            };
        };
    };

...
```
